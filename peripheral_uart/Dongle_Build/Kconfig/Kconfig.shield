## peripheral_uart/Dongle_Build/Kconfig/Kconfig.shield
```kconfig
osource "c:/users/victo/onedrive/desktop/pcb-code/peripheral_uart/boards/shields/*/Kconfig.shield"
osource "C:/ncs/v2.7.0/nrf/boards/shields/*/Kconfig.shield"
```

## peripheral_uart/Dongle_Build/Kconfig/Kconfig.shield.defconfig
```kconfig
osource "c:/users/victo/onedrive/desktop/pcb-code/peripheral_uart/boards/shields/*/Kconfig.defconfig"
osource "C:/ncs/v2.7.0/nrf/boards/shields/*/Kconfig.defconfig"
```
